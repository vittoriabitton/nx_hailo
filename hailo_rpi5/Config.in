## hailo_rpi5/Config.in
```kconfig
# Add project-specific packages for Buildroot here
#
# If these are non-proprietary, please consider contributing them back to
# Nerves or Buildroot.


menu "Custom Packages"

# Hailo AI Accelerator Support packages
source "$NERVES_DEFCONFIG_DIR/packages/spdlog_hailort/Config.in"
source "$NERVES_DEFCONFIG_DIR/packages/hailort/Config.in"
source "$NERVES_DEFCONFIG_DIR/packages/hailort-drivers/Config.in"

endmenu
```

## hailo_rpi5/linux-extras.defconfig
```kconfig
# USB Video Class (UVC)
CONFIG_MEDIA_SUPPORT=y
CONFIG_MEDIA_USB_SUPPORT=y
CONFIG_USB_VIDEO_CLASS=y
CONFIG_USB_VIDEO_CLASS_INPUT_EVDEV=y
CONFIG_VIDEO_V4L2=y
CONFIG_VIDEO_DEV=y
CONFIG_VIDEOBUF2_CORE=y
CONFIG_VIDEOBUF2_V4L2=y
CONFIG_VIDEOBUF2_MEMOPS=y
CONFIG_VIDEOBUF2_VMALLOC=y

# USB Support
CONFIG_USB_SUPPORT=y
CONFIG_USB=y
CONFIG_USB_ARCH_HAS_HCD=y
CONFIG_USB_DEFAULT_PERSIST=y

# Webcam specific
CONFIG_USB_GSPCA=y
```

## hailo_rpi5/packages/hailort-drivers/Config.in
```kconfig
config BR2_PACKAGE_HAILORT_DRIVERS
	bool "hailort-drivers"
	depends on BR2_LINUX_KERNEL
	depends on BR2_PACKAGE_HAILORT
	help
	  HailoRT PCIe drivers for Hailo AI accelerators.

	  https://github.com/hailo-ai/hailort-drivers

comment "hailort-drivers needs a Linux kernel to be built"
	depends on !BR2_LINUX_KERNEL
```
